## conf/layer.conf
```bitbake
# We have a conf and classes directory, add to BBPATH
BBPATH .= ":${LAYERDIR}"

# We have recipes-* directories, add to BBFILES
BBFILES += "${LAYERDIR}/recipes-*/*/*.bb \
            ${LAYERDIR}/recipes-*/*/*.bbappend"

BBFILE_COLLECTIONS += "meta-pcbd-ast"
BBFILE_PATTERN_meta-pcbd-ast = "^${LAYERDIR}/"
BBFILE_PRIORITY_meta-pcbd-ast = "7"

LAYERDEPENDS_meta-pcbd-ast = "core"
LAYERSERIES_COMPAT_meta-pcbd-ast = "honister"

UBOOT_ENV = "u-boot_env"
UBOOT_ENV_SUFFIX = "bin"
```

## meta-congax7-ast2500/conf/layer.conf
```bitbake
# We have a conf and classes directory, add to BBPATH
BBPATH .= ":${LAYERDIR}"

# We have recipes-* directories, add to BBFILES
BBFILES += "${LAYERDIR}/recipes-*/*/*.bb \
            ${LAYERDIR}/recipes-*/*/*.bbappend"

BBFILE_COLLECTIONS += "congax7-ast2500-layer"
BBFILE_PATTERN_congax7-ast2500-layer := "^${LAYERDIR}/"
LAYERSERIES_COMPAT_congax7-ast2500-layer = "honister"
```

## meta-congax7-ast2500/conf/machine/congax7-ast2500.conf
```bitbake
KERNEL_DEVICETREE = "aspeed-ast2500-congax7.dtb"
UBOOT_MACHINE = "ast_g5_phy_config"

require conf/machine/include/ast2500.inc

SERIAL_CONSOLES = "115200;ttyS4"
```
